## app/Kconfig
```kconfig
menu "Firmware Platform"

config FW_SHELL
    bool "Enable firmware shell commands"
    default y
    depends on SHELL

config FW_HEALTH_HEARTBEAT
    bool "Enable heartbeat health service"
    default n

config FW_DISPLAY
    bool "Enable display support"
    default n
    depends on DISPLAY && CHARACTER_FRAMEBUFFER

config FW_SERVICE_DIAGNOSTICS
    bool "Enable persistent diagnostics service"
    default y
    depends on SETTINGS
    select HWINFO
    help
      Stores boot, reset, firmware, and fatal crash metadata in persistent
      settings so the next boot can explain what happened before reset.

config FW_SERVICE_DIAGNOSTICS_REBOOT_ON_FATAL
    bool "Reboot after capturing fatal diagnostics"
    default y
    depends on FW_SERVICE_DIAGNOSTICS
    select REBOOT
    help
      Capture a compact fatal marker in noinit RAM, flush logs, and cold reboot.
      The next boot persists the fatal reason into settings.

config FW_SERVICE_WATCHDOG
    bool "Enable watchdog service"
    default n
    select WATCHDOG
    help
      Initializes the board watchdog, feeds it from a system work item, and
      allows application tasks to register supervision deadlines.

config FW_SERVICE_WATCHDOG_TIMEOUT_MS
    int "Watchdog timeout in milliseconds"
    default 10000
    range 1000 600000
    depends on FW_SERVICE_WATCHDOG

config FW_SERVICE_WATCHDOG_FEED_INTERVAL_MS
    int "Watchdog feed interval in milliseconds"
    default 2500
    range 100 300000
    depends on FW_SERVICE_WATCHDOG
    help
      Periodic feed cadence. Keep this comfortably below the watchdog timeout.

config FW_SERVICE_WATCHDOG_MAX_SUPERVISED_TASKS
    int "Maximum supervised watchdog tasks"
    default 4
    range 0 16
    depends on FW_SERVICE_WATCHDOG

rsource "logging/Kconfig"

endmenu
```

## app/logging/Kconfig
```kconfig
menu "Firmware Logging"
    depends on LOG

module = FW_APP_MAIN
module-str = app/main
source "subsys/logging/Kconfig.template.log_config"

module = FW_PLATFORM_BOARD
module-str = platform/board
source "subsys/logging/Kconfig.template.log_config"

module = FW_SERVICE_DISPLAY
module-str = services/display
source "subsys/logging/Kconfig.template.log_config"

module = FW_SERVICE_HEALTH_HEARTBEAT
module-str = services/health heartbeat
source "subsys/logging/Kconfig.template.log_config"

endmenu
```

## boards/espressif/esp32_oled/Kconfig.defconfig
```kconfig
# SPDX-License-Identifier: Apache-2.0

if BOARD_ESP32_OLED

config HEAP_MEM_POOL_SIZE
	default 16384

endif # BOARD_ESP32_OLED
```

## boards/espressif/esp32_oled/Kconfig.esp32_oled
```kconfig
# SPDX-License-Identifier: Apache-2.0

config BOARD_ESP32_OLED
	select SOC_ESP32_WROOM_32UE_N4
	select SOC_ESP32_PROCPU if BOARD_ESP32_OLED_ESP32_PROCPU
```

## boards/espressif/esp32_oled/board.yml
```yaml
board:
  name: esp32_oled
  full_name: ESP32 OLED development board
  vendor: espressif
  socs:
    - name: esp32
```

## commands/Kconfig
```kconfig
menu "Custom Firmware Shell Commands"
    depends on FW_SHELL

rsource "fw/Kconfig"
rsource "board/Kconfig"
rsource "system/Kconfig"
rsource "health/Kconfig"
rsource "diagnostics/Kconfig"
rsource "settings/Kconfig"
rsource "i2cdetect/Kconfig"

endmenu
```

## commands/board/Kconfig
```kconfig
config FW_CMD_BOARD
    bool "Enable custom board commands"
    depends on FW_SHELL
    help
      Enables project-owned shell commands under: commands/board

      Runtime commands:
        board info
        board caps
```

## commands/board_info/Kconfig
```kconfig
config FW_CMD_BOARD_INFO
    bool "Enable custom board information commands"
    depends on FW_SHELL
    help
      Enables project-owned shell commands under: commands/board_info

      Runtime commands:
        board_info
        board info
        board caps
```

## commands/diagnostics/Kconfig
```kconfig
config FW_CMD_DIAGNOSTICS
    bool "Enable diagnostics commands"
    default y
    depends on FW_SHELL && FW_SERVICE_DIAGNOSTICS
    help
      Enables project-owned diagnostics shell commands:

        diag status
        diag crash
        diag reset-cause
        diag threads
        diag stacks
        diag clear
```

## commands/fw/Kconfig
```kconfig
config FW_CMD_FW
    bool "Enable custom firmware metadata commands"
    depends on FW_SHELL
    help
      Enables project-owned shell commands under: commands/fw

      Runtime commands:
        fw info
        fw version
        fw build
```

## commands/health/Kconfig
```kconfig
config FW_CMD_HEALTH
    bool "Enable health commands"
    depends on FW_SHELL
    help
      Enables project-owned shell commands for health, storage, factory reset,
      and watchdog status.
```

## commands/i2cdetect/Kconfig
```kconfig
config FW_CMD_I2CDETECT
    bool "Enable custom Linux-like i2cdetect command"
    depends on FW_SHELL
    depends on I2C
    select SHELL_GETOPT
    help
      Enables project-owned shell commands under: commands/i2cdetect

      Runtime command:
        i2cdetect [-a] [-r] [-y] <bus>
```

## commands/settings/Kconfig
```kconfig
config FW_CMD_SETTINGS
    bool "Enable custom settings commands"
    depends on FW_SHELL
    depends on SETTINGS
    help
      Enables project-owned shell commands under: commands/settings

      Runtime commands:
        settings list
        settings get <key>
        settings set <key> <value>
        settings reset <key>
        settings save
        settings load
```

## commands/system/Kconfig
```kconfig
config FW_CMD_SYSTEM
    bool "Enable custom system commands"
    depends on FW_SHELL
    help
      Enables project-owned shell commands under: commands/system

      Runtime commands:
        system uptime
        system reset-reason
        system reboot
```

## templates/zephyr_board/stm32_custom/Kconfig.defconfig
```kconfig
# SPDX-License-Identifier: Apache-2.0

if BOARD_STM32_CUSTOM

config HEAP_MEM_POOL_SIZE
	default 16384

endif # BOARD_STM32_CUSTOM
```

## templates/zephyr_board/stm32_custom/Kconfig.stm32_custom
```kconfig
# SPDX-License-Identifier: Apache-2.0

config BOARD_STM32_CUSTOM
	select SOC_SERIES_STM32U5X
```

## templates/zephyr_board/stm32_custom/board.yml
```yaml
board:
  name: stm32_custom
  full_name: STM32 custom board template
  vendor: others
  socs:
    - name: stm32u5a9xx
```

## west.yml
```yaml
manifest:
  version: "1.2"

  remotes:
    - name: zephyrproject-rtos
      url-base: https://github.com/zephyrproject-rtos

  projects:
    - name: zephyr
      remote: zephyrproject-rtos
      revision: bcf31c20f01f11609dbff940483d5172d7897691
      import: true

  self:
    path: zephyr-fw
```
